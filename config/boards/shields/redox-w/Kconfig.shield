## config/boards/shields/redox-w/Kconfig.shield
```kconfig
CONFIG SHIELD_REDOX_CENTRAL_DONGLE
    def_bool $(shields_list_contains,redox_dongle)
    
config SHIELD_REDOX_LEFT
    def_bool $(shields_list_contains,redox_left)
    
config SHIELD_REDOX_RIGHT
    def_bool $(shields_list_contains,redox_right)
```
